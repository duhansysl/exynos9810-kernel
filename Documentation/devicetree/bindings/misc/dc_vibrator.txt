## Documentation/devicetree/bindings/misc/dc_vibrator.txt
```
Samsung DC vibrator

Required properties:

 - compatible: must be "samsung,dc_vibrator".

 - dc_vib,motor_type: must be "COINDC".

Optional properties:

 - dc_vib,gpio_en: GPIO used for enable motor.

 - dc_vib,regulator_name: Regulator name used for enable motor.

 - dc_vib,use_qc_regulator: If DC vibraotr VCC is connected with special QCOM
   pmic ldo, use this property.

 - pinctrl variants.

Examples:

 dc_vibrator {
	 compatible = "samsung,dc_vibrator";
	 status = "okay";
	 dc_vib,gpio_en = <&gpio 1 0>;
	 dc_vib,regulator_name = "VDD_LDO";
	 dc_vib,use_qc_regulator;
	 dc_vib,motor_type = "COINDC";
 };
```

## Documentation/devicetree/bindings/misc/isa1000_vibrator.txt
```
IMAGIS isa1000 haptic vibrator

Required properties:

 - compatible: Must be "imagis,isa1000_vibrator".

 - isa1000,motor_type: "LINEAR"

 - pwms: Pwm phandle of the device.

 - isa1000,frequency: Vibrator frequency value. If 205Hz, "2050".

 - isa1000,duty_ratio: Duty percentage of pwm.

Optional properties:

 - isa1000,gpio_en: GPIO used for enable motor.

 - isa1000,regulator_name: Regulator name used for enable motor.

 - pinctrl variants.

Examples:

 isa1000_vibrator {
	 compatible = "imagis,isa1000_vibrator";
	 status = "okay";
	 pwms = <&pwm 0 50000 0>;
	 isa1000,duty_ratio = <90>;
	 isa1000,frequency = <2050>; /* 205Hz */
	 isa1000,gpio_en = <&gpio 1 0>;
	 isa1000,regulator_name = "VDD_LDO";
	 isa1000,motor_type = "LINEAR";
 };
```

## arch/arm64/configs/apollo_defconfig
```kconfig
#
#
# Apollo Defconfig
#
#
CONFIG_BOEFFLA_WL_BLOCKER=y
CONFIG_CUSTOM_FORCETOUCH=y
CONFIG_SEC_INPUT_BOOSTER=y
CONFIG_ARGOS=y
CONFIG_ARGOS_CLUSTER_NUM=2
CONFIG_PROC_AVC=y
CONFIG_PAGE_BOOST=y
CONFIG_PAGE_BOOST_RECORDING=y
CONFIG_PROCESS_RECLAIM=y
CONFIG_INCREASE_MAXIMUM_SWAPPINESS=y
CONFIG_KSWAPD_CPU=0x3F

#
# MoroSound
#
CONFIG_MORO_SOUND=y

#
# Flar2 Wake Gestures
#
CONFIG_WAKE_GESTURES=y

#
# Wireguard
#
CONFIG_WIREGUARD=y
# CONFIG_WIREGUARD_DEBUG is not set


#
# Scheduler features
#
# CONFIG_PELT_HALFLIFE_32 is not set
CONFIG_PELT_HALFLIFE_16=y
# CONFIG_PELT_HALFLIFE_8 is not set

#
# IKHEADERS
#
CONFIG_IKHEADERS=y

# Enable power efficient workqueues
CONFIG_WQ_POWER_EFFICIENT_DEFAULT=y

#
# Incremental Filesystem
#
CONFIG_INCREMENTAL_FS=y

# NLS Configs for Android StorageManager for OneUI7

CONFIG_NLS_CODEPAGE_437=y
CONFIG_NLS_CODEPAGE_737=y
CONFIG_NLS_CODEPAGE_775=y
CONFIG_NLS_CODEPAGE_850=y
CONFIG_NLS_CODEPAGE_852=y
CONFIG_NLS_CODEPAGE_855=y
CONFIG_NLS_CODEPAGE_857=y
CONFIG_NLS_CODEPAGE_860=y
CONFIG_NLS_CODEPAGE_861=y
CONFIG_NLS_CODEPAGE_862=y
CONFIG_NLS_CODEPAGE_863=y
CONFIG_NLS_CODEPAGE_864=y
CONFIG_NLS_CODEPAGE_865=y
CONFIG_NLS_CODEPAGE_866=y
CONFIG_NLS_CODEPAGE_869=y
CONFIG_NLS_CODEPAGE_936=y
CONFIG_NLS_CODEPAGE_950=y
CONFIG_NLS_CODEPAGE_932=y
CONFIG_NLS_CODEPAGE_949=y
CONFIG_NLS_CODEPAGE_874=y
CONFIG_NLS_ISO8859_8=y
CONFIG_NLS_CODEPAGE_1250=y
CONFIG_NLS_CODEPAGE_1251=y
CONFIG_NLS_ASCII=y
CONFIG_NLS_ISO8859_1=y
CONFIG_NLS_ISO8859_2=y
CONFIG_NLS_ISO8859_3=y
CONFIG_NLS_ISO8859_4=y
CONFIG_NLS_ISO8859_5=y
CONFIG_NLS_ISO8859_6=y
CONFIG_NLS_ISO8859_7=y
CONFIG_NLS_ISO8859_9=y
CONFIG_NLS_ISO8859_13=y
CONFIG_NLS_ISO8859_14=y
CONFIG_NLS_ISO8859_15=y
CONFIG_NLS_KOI8_R=y
CONFIG_NLS_KOI8_U=y
CONFIG_NLS_MAC_ROMAN=y
CONFIG_NLS_MAC_CELTIC=y
CONFIG_NLS_MAC_CENTEURO=y
CONFIG_NLS_MAC_CROATIAN=y
CONFIG_NLS_MAC_CYRILLIC=y
CONFIG_NLS_MAC_GAELIC=y
CONFIG_NLS_MAC_GREEK=y
CONFIG_NLS_MAC_ICELAND=y
CONFIG_NLS_MAC_INUIT=y
CONFIG_NLS_MAC_ROMANIAN=y
CONFIG_NLS_MAC_TURKISH=y
CONFIG_NLS_UTF8=y
```

## arch/arm64/configs/star2lte_defconfig
```kconfig
#
#
# star2lte Defconfig
#
#
CONFIG_VMPRESSURE_LEVEL_MED=60
CONFIG_MUIC_UNIVERSAL=y
# CONFIG_MUIC_UNIVERSAL_MAX77854 is not set
CONFIG_MUIC_UNIVERSAL_MAX77865=y
CONFIG_MUIC_HV=y
# CONFIG_MUIC_HV_12V is not set
CONFIG_MUIC_HV_MAX77865=y
CONFIG_INPUT_TOUCHSCREEN_TCLM=y
# CONFIG_INPUT_TOUCHSCREEN_TCLMV2 is not set
CONFIG_TOUCHSCREEN_SEC_TS=y
# CONFIG_TOUCHSCREEN_SEC_TS_Y771 is not set
# CONFIG_INPUT_WACOM is not set
# CONFIG_EPEN_WACOM_W9018 is not set
CONFIG_MFD_MAX77865=y
CONFIG_CAMERA_CIS_3M3_OBJ=y
# CONFIG_OIS_USE_RUMBA_S4 is not set
# CONFIG_CAMERA_STAR is not set
# CONFIG_CAMERA_CROWN is not set
CONFIG_CAMERA_STAR2=y
CONFIG_OIS_USE_RUMBA_S6=y
# CONFIG_SUPPORT_DIM_FLASH is not set
# CONFIG_SELF_MOVE_3PX is not set
CONFIG_LEDS_MAX77865_RGB=y
CONFIG_FUELGAUGE_MAX77865=y
CONFIG_CHARGER_MAX77865=y
# CONFIG_WIRELESS_FIRMWARE_65 is not set
# CONFIG_SENSORS_SSP_AK09918 is not set
# CONFIG_SENSORS_SSP_LIGHT_MAX_GAIN_2BYTE is not set
CONFIG_SENSORS_SSP_STAR=y
# CONFIG_SENSORS_SSP_CROWN is not set
```

## drivers/battery/Kconfig
```kconfig
#
# battery driver configuration
#

comment "Battery drivers"

config BATTERY_SAMSUNG
	tristate "samsung battery driver"
	help
	 Say Y to include support for samsung battery driver
	 This battery driver integrated all battery-related functions
	 To see battery-related functions,
	 refer to sec_charging_common.h

config BATTERY_SAMSUNG_V2
	tristate "samsung battery driver version 2"
	default n
	depends on BATTERY_SAMSUNG
	help
	 Say Y to include support for samsung battery driver
	 This battery driver integrated all battery-related functions
	 To see battery-related functions,
	 refer to sec_charging_common.h

config BATTERY_SAMSUNG_LEGO_STYLE
	tristate "samsung battery driver (lego style)"
	default n
	depends on BATTERY_SAMSUNG
	help
	 Say Y to include support for samsung battery driver
	 This battery driver integrated all battery-related functions
	 To see battery-related functions,
	 refer to sec_charging_common.h

if BATTERY_SAMSUNG_LEGO_STYLE
source "drivers/battery/charger/Kconfig"
source "drivers/battery/common/Kconfig"
source "drivers/battery/fuelgauge/Kconfig"
source "drivers/battery/wireless/Kconfig"
endif # BATTERY_SAMSUNG_LEGO_STYLE
```

## drivers/battery/charger/Kconfig
```kconfig
config CHARGER_DUMMY
	tristate "dummy charger driver"
	default n
	depends on BATTERY_SAMSUNG
	help
	 Say Y to include support
	 for dummy charger driver.
	 This driver source code implemented
	 skeleton source code for charger functions.

config CHARGER_MAX77705
	tristate "MAX77705 battery charger support"
	depends on BATTERY_SAMSUNG
	help
	  Say Y here to enable support for the MAX77705 charger

config SWITCHING_S2ASL01
    tristate "S2ASL01 SWITCHING IC support"
    depends on I2C
    help
	  Say Y here to enable support for S2ASL01 switching driver.

config CHARGER_PCA9468
	tristate "PCA9468 charger driver"
	default n
	depends on DIRECT_CHARGING
	help
	  Say Y here to enable support for the PCA9468 charger

config CHARGER_SM5705
	tristate "SM5705 battery charger support"
	depends on BATTERY_SAMSUNG
	help
	  Say Y here to enable support for the SM5705 charger

config CHARGER_SMB1351
        tristate "SMB1351 charger driver"
        default n
        help
         Say Y here to support for the smb1351 charger
         The SMB1351 is a slave charger that extends
         the current capability of an existing charging solution.

config CHARGER_S2MU107
    tristate "S2MU107 charger support"
    depends on (MFD_S2MU107) && I2C
    help
     Say Y here to enable support for the S2MU107 charger.
     S2MU107 charger is an AFC compatible charging IC.
     S2MU107 charger is dependent on MFD_S2MU107
     so it needs to be defined.

config CHARGER_S2MU107_DIRECT
	tristate "S2MU107 direct charger support"
	depends on (MFD_S2MU107) && I2C
	help
	 Say Y here to enable support for the S2MU107 direct charger.
	 S2MU107 direct charger is dependent on MFD_S2MU107
	 so it needs to be defined.

config PM_S2MU107
	tristate "S2MU107 power meter support"
	depends on (MFD_S2MU107) && I2C
	help
	 Say Y here to enable support for the S2MU107 power meter.
	 S2MU107 power meter is dependent on MFD_S2MU107
	 so it needs to be defined.
```

## drivers/battery/common/Kconfig
```kconfig
config BATTERY_SAMSUNG_DATA_FILE
	depends on BATTERY_SAMSUNG
	string "samsung battery data file"
	default "default_battery_data.h"
	help
	 Path to the battery data file.

config SLOW_CHARGING_CURRENT_STANDARD
	int "slow charging"
	depends on BATTERY_SAMSUNG
	default "1000"
	help
	 Value for standard of slow-charging.

config CHARGING_VZWCONCEPT
	tristate "VZW concept about the charging"
	default n
	depends on BATTERY_SAMSUNG
	help
	 Say Y to include support for the VZW concepts.

config CALC_TIME_TO_FULL
	tristate "calculate time to full"
	default n
	depends on BATTERY_SAMSUNG
	help
	 Say Y to use calc time to full function.

config MULTI_CHARGING
	bool "support for multi charger ICs"
	help
	 Say Y to include support for multi charger ICs

config STEP_CHARGING
	bool "support for step charging"
	help
	 Say Y to include support for step charging

config ENABLE_FULL_BY_SOC
	bool "make full by soc 100%"
	help
	default n
	 Say Y to include support to make full by soc 100%

config DIRECT_CHARGING
	bool "support for direct charging"
	help
	 Say Y to include support for direct charging

config UPDATE_BATTERY_DATA
	bool "support for updating battery data"
	default n
	depends on BATTERY_SAMSUNG && OF
	help
	 Say Y to include support for step charging

config AFC_CURR_CONTROL_BY_TEMP
	tristate "fast charging current control by temp"
	default n
	depends on BATTERY_SAMSUNG
	help
	 Say Y to set afc current control by temp

config BATTERY_CISD
	 bool "support for cisd"
	 help
	 Say Y to include support for cisd
	 cisd means cell internal short detection

config PREVENT_SOC_JUMP
	tristate "prevent soc jump at full-charged"
	default n
	depends on BATTERY_SAMSUNG
	help
		Say Y to prevent soc jump

config CS100_JPNCONCEPT
	tristate "cs100 command support"
	depends on BATTERY_SAMSUNG && I2C
	help
	 Say Y here to support for CS100 command to stop when full-charged
	 on wireless charging for JPN models

config AFC_CHARGER_MODE
	bool "afc charging support in sec battery driver"
	default n
	help
	  Say Y to include support for sec afc charging support

config SAMSUNG_LPM_MODE
	bool "Off charging mode support in sec battery driver"
	default n
	help
	  Say Y to include support for sec off charging support
	  This value defined at bootloader.
	  Before enable this feature,
	  implemet power off charging in the bootloader.

config SAMSUNG_BATTERY_ENG_TEST
	bool "enable ENG mode for battery test"
	default n
	help
	  Say Y to include support for battery test
	  enable this feature only ENG mode
	  this featuren must disabled user binary
	  stability test etc..

config SAMSUNG_BATTERY_FACTORY
	bool "enable for factory test"
	default n
	help
	  Say Y to include support for factory test
	  enable this feature only factory mode
	  this featuren must disabled user binary
	  stability test etc..

config SAMSUNG_BATTERY_DISALLOW_DEEP_SLEEP
	bool "Disallow deep sleep during charging"
	default n
	depends on BATTERY_SAMSUNG && (ARCH_MSM8974 || ARCH_APQ8084)
	help
	  Say Y to include support
	  Disallow deep sleep during charging for stablity.

config DISABLE_SAVE_CAPACITY_MAX
	bool "Disable to save capacity max in efs"
	default n
	depends on BATTERY_SAMSUNG
	help
		Say Y to include support to disable it
		capacity_max is saved in /efs/Battery/batt_capacity_max
		capacity_max is restored after boot up
		You can find the code in healthd

config SIOP_CHARGING_LIMIT_CURRENT
	int "Siop charging limit current"
	default 0
	help
	  set SIOP charging limit current.

config EN_OOPS
	bool "enable oops filter"
	default n
	help
	  Say Y to enable oops filter

config USE_POGO
	bool "enable pogo charging"
	default n
	help
	  Say Y to enable CONFIG_USE_POGO

config MACH_KOR_EARJACK_WR
	bool "enable earjack-noise workaround"
	default n
	depends on BATTERY_SAMSUNG
	help
	  Say Y to enable earjack-noise workaround at charging

config STORE_MODE
	bool "enable store mode"
	default n
	help
	  Say Y to enable CONFIG_STORE_MODE

config SW_SELF_DISCHARGING
	bool "enable sw_self_discharging"
	default n
	help
	  Say Y to enable CONFIG_SW_SELF_DISCHARGING

config BATTERY_AGE_FORECAST
	tristate "battery age forecast"
	default n
	help
	  Say Y to use calc time to full function.

config ENG_BATTERY_CONCEPT
       bool "enable temp block"
       default n
       help
	 Say Y to enable CONFIG_ENG_BATTERY_CONCEPT

config QH_ALGORITHM
	bool "enable QH algorithm"
	default n
	help
		Say Y to enable CONFIG_QH_ALGORITHM to measure leakges of the battery
		using raw coulomb count generated by the device

config BATTERY_NOTIFIER
	bool "battery notifier"
	default n
	help
	  Say Y to enable battery notifier

config LIMIT_CHARGING_DURING_CALL
	bool "limit charging during call"
	default n
	help
	  Say Y to limit charging during call

config ENABLE_100MA_CHARGING_BEFORE_USB_CONFIGURED
	bool "enable 100mA before usb configured"
	default n
	help
	  Say Y to enable 100mA before usb configured

config TABLET_MODEL_CONCEPT
	bool "tablet model concept"
	default n
	help
	  Say Y to enable tablet model concept

config OTG_OVERCURRENT_BY_CHGIN
	bool "enable otg overcurrent detection by chgin workaround"
	default n
	help
	  Say Y to enable otg overcurrent detection by chgin workaround
	  for charger ICs have otg retrying issues from OVP IC specification

config SWITCHING_S2ASL01
    tristate "S2ASL01 SWITCHING IC support"
    depends on I2C
    help
	  Say Y here to enable support for S2ASL01 switching driver.

config DUAL_BATTERY
    tristate "DUAL BATTERY support"
    depends on I2C
    help
	  Say Y here to enable support for dual battery

config ISDB_CHARGING_CONTROL
    tristate "ISDB CHARGING CONTROL support"
    depends on I2C
    help
	  Say Y here to enable support for isdb

config PREVENT_USB_CONN_OVERHEAT
    bool "enable prevent usb conn overheat"
    default n
    help
	  Say Y to enable CONFIG_PREVENT_USB_CONN_OVERHEAT
```

## drivers/battery/fuelgauge/Kconfig
```kconfig
config FUELGAUGE_DUMMY
	tristate "dummy fuel gauge driver"
	default n
	depends on BATTERY_SAMSUNG
	help
	 Say Y to include support
	 for dummy fuel gauge driver.
	 This driver source code implemented
	 skeleton source code for fuel gauge functions.

config FUELGAUGE_MAX77705
	tristate "MAX77705 fuel gauge driver"
	default n
	depends on BATTERY_SAMSUNG
	help
	 Say Y to include support
	 for MAXIM MAX77705 fuel gauge driver.
	 This fuel-gauge can be used in coulomb-counting mode.

config FUELGAUGE_SM5705
	tristate "Siliconmitus SM5705 Fuel Gauge"
	default n
	depends on I2C
	help
	  SM5705 is fuel-gauge systems for lithium-ion (Li+) batteries
	  in handheld and portable equipment. The SM5705 is configured
	  to operate with a single lithium cell

config FUELGAUGE_S2MU107
	tristate "S2MU107 fuel gauge driver"
	default n
	depends on I2C
	help
	 Say Y to include support
	 for S.LSI S2MU107 fuel gauge driver.
	 Ths fuel-gauge supports current tracking and
	 voltage tracking to model the battery SOC.

config FUELGAUGE_S2MU107_TEMP_COMPEN
	tristate "S2MU107 fuel gauge temperature compensation"
	default n
	depends on (FUELGAUGE_S2MU107) && I2C
	help
	 Say Y to enable temperature compensation
	 for S.LSI S2MU107 fuel gauge driver.

config FUELGAUGE_S2MU107_BATCAP_LRN
	tristate "S2MU107 fuel gauge battery capacity learning"
	default n
	depends on (FUELGAUGE_S2MU107) && I2C
	help
	 Say Y to enable battery capacity learning
	 for S.LSI S2MU107 fuel gauge driver.

config FUELGAUGE_S2MU107_USE_10MILLIOHM
	tristate "S2MU107 fuel gauge with 10mohm resistor"
	default n
	depends on (FUELGAUGE_S2MU107) && I2C
	help
	 Say Y to use 10mohm current sensing resistor
	 instead of 5mohm for S.LSI S2MU107 fuel gauge.
```
