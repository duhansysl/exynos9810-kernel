## drivers/battery/wireless/Kconfig
```kconfig
config WIRELESS_AUTH
	 bool "support for samsung wireless authentication massage"
	 help
	 Say Y to include support for swam
	 samsung wireless authentication massage 

config WIRELESS_CHARGER_HIGH_VOLTAGE
	tristate "high voltage wireless charger"
	depends on BATTERY_SAMSUNG && I2C
	help
	  Say Y here to enable support for the wireless charger charger
	  driver.

config WIRELESS_NO_HV
	tristate "wireless no hv"
	depends on BATTERY_SAMSUNG && I2C
	help
	  Say Y here to disable HV wireless charging
	  driver.

config WIRELESS_CHARGER_MFC
	tristate "MFC IC charger support"
	depends on BATTERY_SAMSUNG && I2C
	help
	  Say Y here to enable support for the MFC IC
	  MFC wireless charger driver.

config WIRELESS_FIRMWARE_UPDATE
	tristate "p9220 battery charger support"
	depends on BATTERY_SAMSUNG
	help
	  Say Y here to enable support for the wireless charger firmware update
	  wireless charger IC firmware update.

config WIRELESS_TX_MODE
	bool "wireless power sharing support in sec battery driver"
	default n
	depends on BATTERY_SAMSUNG
	help
	  Say Y to include support for sec afc charging support

config WIRELESS_FIRMWARE_65
	tristate "p9220 battery charger support"
	depends on BATTERY_SAMSUNG
	help
	  Say Y here to enable support for the wireless charger firmware update
	  wireless charger IC firmware update.
```

## drivers/ccic/Kconfig
```kconfig
#
# CCIC devices
#

comment "CCIC configs"

config USE_CCIC
	bool "Using USBPD device driver"
	depends on I2C
	default n
	help
	  If you say yes here you will get support for
	  the USB PD(Power Delivery) device driver.

config CCIC_NOTIFIER
	bool "CCIC notifier support"
	depends on I2C
	default n
	help
	  If you say yes here you will get support for
	  the CCIC attached device status change notification.

config CCIC_S2MM003 
	bool "CCIC S2MM003"
	depends on I2C 
	default n
	help
	  If you say yes here you will get support for
	  s2mm003 ccic full version chipset 

config CCIC_S2MM005 
	bool "CCIC S2MM005"
	depends on I2C 
	default n
	help
	  If you say yes here you will get support for
	  s2mm005 ccic full version chipset

config CCIC_S2MU107
	bool "Using S2MU107 USB PD"
	depends on USE_CCIC
	default n
	help
	  If you say yes here you will get support for
	  for the S2MU107 USBPD chip. 

config CCIC_S2MU106
	bool "Using S2MU106 USB PD"
	depends on USE_CCIC
	default n
	help
	  If you say yes here you will get support for
	  for the S2MU106 USBPD chip. 

config CCIC_MAX77705
	bool "CCIC 77705"
	depends on I2C
	default n
	help
	  If you say yes here you will get support for
	  max77705 ccic full version chipset

config CCIC_MAX77705_DEBUG
	bool "CCIC 77705 DEBUG"
	depends on CCIC_MAX77705
	default n
	help
	  If you say yes here you will get support for
	  debugging feature with max77705 ccic chipset

config MAX77705_FW_PID06_SUPPORT
	bool "support MAX77705 FW PID 0x06"
	depends on CCIC_MAX77705
	default n
	help
	  If you say yes here you will get support for
	  specified firmware with max77705 ccic chipset

config CCIC_NOTIFIER
	bool "CCIC notifier support"
	depends on I2C
	default n
	help
	  If you say yes here you will get support for
	  the CCIC attached device status change notification.

config CCIC_ALTERNATE_MODE 
	bool "support CCIC alternate mode"
	depends on I2C
	default n
	help
	  If you say yes here you will get support for
	  alternate mode

config CCIC_LPM_ENABLE
	bool "Support LPM ENABLE"
	depends on CCIC_S2MM005
	default n
	help
	  If you say yes here you will get support for
	  lpm enable

config CCIC_WATER_DETECT
	bool "support WATER DETECT"
	depends on CCIC_S2MM005
	default n
	help
	  If you say yes here you will get support for
	  water detect Enable

config PDIC_PD30
	bool "support PD30"
	depends on USE_CCIC
	default n
	help
	  If you say yes here you will get support for PD30

config CCIC_AUTO_PPS
	bool "support auto pps"
	depends on USE_CCIC
	default n
	help
	  If you say yes here you will get support for
	  sending pps message automatically

config S2MU106_PDIC_TRY_SNK
  bool "Using Type-C try.SNK"
  depends on I2C && (MFD_S2MU106 || PM_S2MU106)
  default n
  help
    If you say yes here you will get support for
    the S2MU106 Type-C try.SNK.
    The device prefer to work with snk.
    This feature is in typec specificaion.
```

## drivers/gpu/arm/tHEx/Kconfig
```kconfig
#
# (C) COPYRIGHT 2012-2013 ARM Limited. All rights reserved.
#
# This program is free software and is provided to you under the terms of the
# GNU General Public License version 2 as published by the Free Software
# Foundation, and any use by you of this program is subject to the terms
# of such GNU licence.
#
# A copy of the licence is included with the program, and can also be obtained
# from Free Software Foundation, Inc., 51 Franklin Street, Fifth Floor,
# Boston, MA  02110-1301, USA.
#
#


menuconfig MALI_THEX
	tristate "Mali-THEX support"
	default n
	help
	  Enable this option to build support for the ARM Mali-G72 GPU.

	  To compile this driver as a module, choose M here:
	  this will generate a single module, called mali_kbase.

choice
	prompt "version Configuration"
	depends on MALI_THEX
	default MALI_THEX_R9P0
	help
	  Select the gpu support version.

config MALI_THEX_R5P0
	depends on MALI_THEX
	bool "Heimdall r5p0 driver"

config MALI_THEX_R7P0
	depends on MALI_THEX
	bool "Heimdall r7p0 driver"

config MALI_THEX_R8P0
	depends on MALI_THEX
	bool "Heimdall r8p0 driver"

config MALI_THEX_R9P0
	depends on MALI_THEX
	bool "Heimdall r9p0 driver"

endchoice

if MALI_THEX_R5P0
source "drivers/gpu/arm/tHEx/r5p0/Kconfig"
endif
if MALI_THEX_R7P0
source "drivers/gpu/arm/tHEx/r7p0/Kconfig"
endif
if MALI_THEX_R8P0
source "drivers/gpu/arm/tHEx/r8p0/Kconfig"
endif
if MALI_THEX_R9P0
source "drivers/gpu/arm/tHEx/r9p0/Kconfig"
endif
```

## drivers/gud/Kconfig
```kconfig
#
# Mobicore Configuration
#

if SOC_EXYNOS8895
source "drivers/gud/gud-exynos8895/Kconfig"
endif

#if SOC_EXYNOS9810
#source "drivers/gud/gud-exynos9810_Q_Launching/Kconfig"
#endif

if SOC_EXYNOS9810
source "drivers/gud/gud-exynos9810/Kconfig"
endif
```

## drivers/gud/gud-exynos9810/Kconfig
```kconfig
#
# Trustonic drivers configuration
#
config TRUSTONIC_TEE
    tristate "Trustonic TEE Driver"
    depends on ARM || ARM64
    default y
    ---help---
      Enable Trustonic TEE support

config TRUSTONIC_TEE_LPAE
    bool "Trustonic TEE uses LPAE"
    depends on TRUSTONIC_TEE
    default y if ARM64
    default n if ARM
    ---help---
      Enable Trustonic TEE 64-bit physical addresses support

config TRUSTONIC_TEE_DEBUG
    bool "Trustonic TEE driver debug mode"
    depends on TRUSTONIC_TEE
    default n
    ---help---
      Enable the debug mode in the Trustonic TEE Driver.

config TRUSTONIC_TRUSTED_UI
    tristate "Trustonic Trusted UI"
    depends on TRUSTONIC_TEE
    ---help---
      Enable Trustonic Trusted User Interface

config TRUSTONIC_TRUSTED_UI_FB_BLANK
    bool "Trustonic Trusted UI with fb_blank"
    depends on TRUSTONIC_TRUSTED_UI
    ---help---
    Blank the framebuffer before starting a TUI session

config TRUSTED_UI_TOUCH_ENABLE
    bool "TBase Trusted UI use touch related code"
    depends on TRUSTONIC_TRUSTED_UI

config GUD_DRIVER_Q_LAUNCHING
    bool "Trustonic for Q luanching"
    default n

#ExySp
source "drivers/gud/gud-exynos9810/sec-os-ctrl/Kconfig"
source "drivers/gud/gud-exynos9810/sec-os-booster/Kconfig"
```

## drivers/input/touchscreen/himax/himax_83102E/Kconfig
```kconfig
#
# Himax Touchscreen driver configuration
#

config TOUCHSCREEN_HIMAX_COMMON
	tristate "HIMAX chipset i2c touchscreen"
	depends on TOUCHSCREEN_HIMAX_CHIPSET
	help
		This enables support for HIMAX CHIPSET over I2C based touchscreens.

config TOUCHSCREEN_HIMAX_I2C
	tristate "HIMAX chipset i2c touchscreen"
	depends on TOUCHSCREEN_HIMAX_COMMON
	help
		This enables support for HIMAX I2C based touchscreens.

config TOUCHSCREEN_HIMAX_SPI
	tristate "HIMAX chipset spi touchscreen"
	depends on TOUCHSCREEN_HIMAX_COMMON
	help
		This enables support for HIMAX SPI based touchscreens.

# ***************** On-cell Start *****************
config TOUCHSCREEN_HIMAX_ONCELL
	tristate "HIMAX chipset on-cell function"
	depends on TOUCHSCREEN_HIMAX_COMMON
	help
		This enables support for HIMAX CHIPSET of on-cell function.

config TOUCHSCREEN_HIMAX_IC_HX852xH
	tristate "HIMAX chipset HX852xH function"
	depends on TOUCHSCREEN_HIMAX_ONCELL
	help
		This enables support for HIMAX CHIPSET of HX852xH.

config TOUCHSCREEN_HIMAX_IC_HX852xG
	tristate "HIMAX chipset HX852xG function"
	depends on TOUCHSCREEN_HIMAX_ONCELL
	help
		This enables support for HIMAX CHIPSET of HX852xG.

# ***************** On-cell End *******************

# ***************** In-cell Start *****************
config TOUCHSCREEN_HIMAX_INCELL_CORE
	tristate "HIMAX chipset in-cell function"
	depends on TOUCHSCREEN_HIMAX_COMMON
	help
		This enables support for HIMAX CHIPSET of in-cell function.

config TOUCHSCREEN_HIMAX_IC_HX83191
	tristate "HIMAX chipset HX83191 function"
	depends on TOUCHSCREEN_HIMAX_INCELL_CORE
	help
		This enables support for HIMAX CHIPSET of HX83191.

config TOUCHSCREEN_HIMAX_IC_HX83113
	tristate "HIMAX chipset HX83113 function"
	depends on TOUCHSCREEN_HIMAX_INCELL_CORE
	help
		This enables support for HIMAX CHIPSET of HX83113.

config TOUCHSCREEN_HIMAX_IC_HX83112
	tristate "HIMAX chipset HX83112 function"
	depends on TOUCHSCREEN_HIMAX_INCELL_CORE
	help
		This enables support for HIMAX CHIPSET of HX83112.

config TOUCHSCREEN_HIMAX_IC_HX83111
	tristate "HIMAX chipset HX83111 function"
	depends on TOUCHSCREEN_HIMAX_INCELL_CORE
	help
		This enables support for HIMAX CHIPSET of HX83111.

config TOUCHSCREEN_HIMAX_IC_HX83106
	tristate "HIMAX chipset HX83106 function"
	depends on TOUCHSCREEN_HIMAX_INCELL_CORE
	help
		This enables support for HIMAX CHIPSET of HX83106.

config TOUCHSCREEN_HIMAX_IC_HX83103
	tristate "HIMAX chipset HX83103 function"
	depends on TOUCHSCREEN_HIMAX_INCELL_CORE
	help
		This enables support for HIMAX CHIPSET of HX83103.

config TOUCHSCREEN_HIMAX_IC_HX83102
	tristate "HIMAX chipset HX83102 function"
	depends on TOUCHSCREEN_HIMAX_INCELL_CORE
	help
		This enables support for HIMAX CHIPSET of HX83102.

config SEC_AOT
	tristate "HIMAX chipset HX83102 function"
	depends on TOUCHSCREEN_HIMAX_INCELL_CORE
	help
		This enables support for notify AOT to LCD.

# ***************** In-cell End *******************

config TOUCHSCREEN_HIMAX_DEBUG
	tristate "HIMAX debug function"
	depends on TOUCHSCREEN_HIMAX_INCELL_CORE || TOUCHSCREEN_HIMAX_ONCELL
	help
		This enables support for HIMAX debug function.

config TOUCHSCREEN_HIMAX_INSPECT
	tristate "HIMAX inspect function"
	depends on TOUCHSCREEN_HIMAX_INCELL_CORE || TOUCHSCREEN_HIMAX_ONCELL
	help
		This enables support for HIMAX debug function.

config TOUCHSCREEN_HIMAX_EMBEDDED_FIRMWARE
	tristate "HIMAX embedded firmware function"
	depends on TOUCHSCREEN_HIMAX_INCELL_CORE || TOUCHSCREEN_HIMAX_ONCELL
	help
		This enables built-in FW inside kernel as binary array

config HMX_DB
	tristate "HIMAX driver test over Dragon Board"
	depends on TOUCHSCREEN_HIMAX_COMMON
	help
		This enables support for HIMAX driver test over Dragon Board.
```

## drivers/input/wacom/Kconfig
```kconfig
#
# Wacom configuration
#

config INPUT_WACOM
	tristate "Wacom penabled i2c touchscreen"
	depends on I2C
	help
	  Say Y here if you have an Wacom penabled i2c touchscreen
	  connected to your system.

	  If unsure, say N.

	  To compile this driver as a module, choose M here: the
	  module will be called wacom_GXXX.

config EPEN_WACOM_W9018
	tristate "Wacom W9018 penabled i2c touchscreen"
	depends on I2C
	help
	  Say Y here if you have an Wacom G10PM penabled i2c touchscreen
	  connected to your system.

	  If unsure, say N.

	  To compile this driver as a module, choose M here: the
	  module will be called wacom_W9018.

config EPEN_WACOM_W9019
	tristate "Wacom W9019 penabled i2c touchscreen"
	depends on I2C
	help
	  Say Y here if you have an Wacom G10PM penabled i2c touchscreen
	  connected to your system.

	  If unsure, say N.

	  To compile this driver as a module, choose M here: the
	  module will be called wacom_W9019.
```

## drivers/kperfmon/Kconfig
```kconfig
#
# Samsung Performance Logging system
#

menu "samsung Performace manager"

config KPERFMON
	bool "Enable performance log"
	default y
	help
		Samsung performance log(OLOG).
		Say Y here if enable performance olog driver to do logging system resources.
		When some delay occurs in the kernel, native or user space,
		the logging information should be restored into the system.

endmenu
```
