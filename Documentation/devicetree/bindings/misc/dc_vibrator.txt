## drivers/muic/Kconfig
```kconfig
#
# MUIC devices
#

comment "MUIC configs"

config USE_MUIC
	bool "Using MUIC device driver"
	depends on I2C
	default n
	help
	  If you say yes here you will get support for
	  the MUIC device driver.

config USE_SAFEOUT
	bool "Using SAFEOUT device driver"
	depends on I2C
	default n
	help
	  If you say yes here you will get support for
	  the SAFEOUT device driver.

config MUIC_NOTIFIER
	bool "MUIC notifier support"
	depends on USE_MUIC
	default n
	help
	  If you say yes here you will get support for
	  the MUIC attached device status change notification.

config MUIC_MANAGER
	bool "MUIC Manager supports CCIC chip interface"
	depends on USE_MUIC
	default n
	help
	  If you say yes here you will get support manager for the CCIC chip.

config MUIC_CORE
	bool "Supports MUIC Core"
	depends on USE_MUIC
	default n
	help
	  If you say yes here you will get support for the MUIC Core functionalities

config MUIC_HV
	bool "MUIC_HV"
	depends on USE_MUIC
	default n
	help
	  If you say yes here you will get support for the AFC.

config MUIC_HV_12V
	bool "MUIC_HV_12V"
	depends on MUIC_HV
	default n
	help
	  If you say yes here you will get support for the AFC.

config MUIC_SUPPORT_CCIC
	bool "MUIC supports CCIC chip interface"
	depends on USE_MUIC
	default n
	help
	  If you say yes here you will get support for the CCIC chip.

config MUIC_MAX77705
        bool "Using MAX77705 MUIC"
        depends on USE_MUIC
        default n
        help
          If you say yes here you will get support for
          the MAX77705 MUIC chip.
	  To enable this driver,
	  USE_MUIC should be enabled.

config HV_MUIC_MAX77705_AFC
        bool "Using MAX77705 AFC MUIC"
        depends on MUIC_MAX77705
        default n
        help
          If you say yes here you will get support for
	  the MAX77705 AFC MUIC.
	  To enable this driver,
	  MUIC_MAX77705 should be enabled.

config MUIC_MAX77705_CCIC
        bool "Using MAX77705 MUIC supports CCIC chip interface"
        depends on MUIC_MAX77705 && MUIC_SUPPORT_CCIC
        default n
        help
          If you say yes here you will get support for
	  the CCIC chip with MAX77705 MUIC.
	  To enable this driver,
	  MUIC_MAX77705 and MUIC_SUPPORT_CCIC should be enabled.

config MUIC_SUPPORT_POWERMETER
	bool "MUIC supports PM chip interface"
	depends on USE_MUIC
	default n
	help
	  If you say yes here you will get support for the Power Meter.

config MUIC_S2MU004
	bool "Using S2MU004 MUIC"
	depends on USE_MUIC && MFD_S2MU004
	default n
	help
	  If you say yes here you will get support for the S2MU004 MUIC chip.

config MUIC_SUPPORT_CCIC_OTG_CTRL
	bool "MUIC Allows CCIC to Disable MUIC VBUS DET"
	depends on USE_MUIC
	default n
	help
	  If you say yes here you will get support for this.

config MUIC_SUPPORT_TYPEB
	bool "Using Type-B Features"
	depends on USE_MUIC
	default n
	help
	  If you say yes here you will get support for the TypeB Features.

config MUIC_SYSFS
	bool "Using muic sysfs Features"
	depends on USE_MUIC
	default n
	help
	  If you say yes here you will get support for the muic sysfs.

config MUIC_SUPPORT_VBUS_BOOST
	bool "Using muic Features for vbus boost"
	depends on USE_MUIC && BATTERY_SAMSUNG_V2
	default n
	help
	  If you say yes here you will get support for the muic vbus boosting.

config MUIC_SKIP_INCOMPLETE_INSERT
	bool "Not Using muic Features for incomplete insert"
	depends on USE_MUIC
	default n
	help
	  If you say yes here you will get support for the muic incomplete insert.

config HV_MUIC_S2MU004_AFC
	bool "Using S2MU004 MUIC AFC"
	depends on MUIC_S2MU004
	default n
	help
	  If you say yes here you will get support for the AFC.

config HV_MUIC_VOLTAGE_CTRL
	bool "Using AFC Voltage control functionality"
	depends on MUIC_HV_S2MU004_AFC || MUIC_HV
	default n
	help
	  If you say yes here you will get support for
	  the AFC voltage control functionality.

config MUIC_S2MU004_AFC_DISABLE
	bool "Using AFC disable functionality"
	depends on MUIC_S2MU004
	default n
	help
	  If you say yes here you will get support for
	  the AFC disable control functionality.

config MUIC_S2MU005
	bool "Using S2MU005 MUIC"
	depends on USE_MUIC && MFD_S2MU005
	default n
	help
	  If you say yes here you will get support for
	  for the S2MU005 MUIC chip.

config MUIC_S2MU005_ENABLE_AUTOSW
	bool "Using S2MU005 MUIC ENABLE AUTOSW"
	depends on MUIC_S2MU005
	default n
	help
	  If you say yes here you will get support for
	  for the S2MU005 MUIC chip ENABLE AUTOSW feature.

config MUIC_S2MU005_DISCHARGING_WA
	bool "Using S2MU005 MUIC DISCHARGING WORKAROUND"
	depends on MUIC_S2MU005
	default n
	help
		If you say yes here you will get support for
		for the S2MU005 MUIC chip DISCHARGING WA feature.

config MUIC_S2MU106
	bool "Using S2MU106 MUIC"
	depends on USE_MUIC && MFD_S2MU106
	default n
	help
	  If you say yes here you will get support for the S2MU106 MUIC chip.

config HV_MUIC_S2MU106_AFC
	bool "Using S2MU106 MUIC AFC"
	depends on MUIC_HV && MUIC_S2MU106
	default n
	help
	  If you say yes here you will get support for the AFC.

config MUIC_S2MU106_RID
	bool "Using S2MU106 MUIC RID"
	depends on MUIC_S2MU106
	default n
	help
	  If you say yes here you will get support for the S2MU106 MUIC RID functions.

config S2MU106_TYPEC_WATER
	bool "Using S2MU106 Type-C Water Detection"
	depends on MUIC_S2MU106_RID
	default n
	help
	  If you say yes here you will get support for
	  the S2MU106 Type-C Water functions.

config MUIC_S2MU205
	bool "Using S2MU205 MUIC"
	depends on USE_MUIC && MFD_S2MU205
	default n
	help
	  If you say yes here you will get support for the S2MU205 MUIC chip.

config MUIC_S2MU205_RID
	bool "Using S2MU205 MUIC RID"
	depends on MUIC_S2MU205
	default n
	help
	  If you say yes here you will get support for the S2MU205 MUIC RID functions.

config S2MU205_TYPEC_WATER
	bool "Using S2MU205 Type-C Water Detection"
	depends on MUIC_S2MU205_RID
	default n
	help
	  If you say yes here you will get support for
	  the S2MU205 Type-C Water functions.

config MUIC_S2MU107
	bool "Using S2MU107 MUIC"
	depends on USE_MUIC && MFD_S2MU107
	default n
	help
	  If you say yes here you will get support for the S2MU107 MUIC chip.

config HV_MUIC_S2MU107_AFC
	bool "Using S2MU107 MUIC AFC"
	depends on MUIC_HV && MUIC_S2MU107
	default n
	help
	  If you say yes here you will get support for the AFC.

config MUIC_S2MU107_RID
	bool "Using S2MU107 MUIC RID"
	depends on MUIC_S2MU107
	default n
	help
	  If you say yes here you will get support for the S2MU106 MUIC RID functions.

config S2MU107_TYPEC_WATER
	bool "Using S2MU107 Type-C Water Detection"
	depends on MUIC_S2MU107_RID
	default n
	help
	  If you say yes here you will get support for
	  the S2MU106 Type-C Water functions.

config MUIC_S2MU107_ENABLE_AUTOSW
	bool "Using S2MU107 MUIC ENABLE AUTOSW"
	depends on MUIC_S2MU107
	default n
	help
	  If you say yes here you will get support for
	  for the S2MU107 MUIC chip ENABLE AUTOSW feature.

config HICCUP_CHARGER
	bool "Using HICCUP charger"
	depends on USE_MUIC
	default n
	help
		If you say yes here you will get support for
		for the hiccup charger feature.
config CP_UART_SWITCH
	bool "Using CP UART PATH"
	depends on USE_MUIC
	default n
	help
		If you say yes here you will get support for
		for the cp uart path feature.

config NEW_FACTORY_JIGONB
	bool "Using JIGONB control"
	depends on USE_MUIC
	default n
	help
		If you say yes here you will get support for
		for the jigonb control.

config NEW_FACTORY_UART
	bool "Using factory uart control"
	depends on USE_MUIC
	default n
	help
		If you say yes here you will get support for
		for the factory uart control.

config MUIC_INCOMPATIBLE_VZW
	bool "Using Verizon incomatible type"
	depends on USE_MUIC
	default n
	help
		If you say yes here you will get support for
		for the Verizon incomatible type cable.

config MUIC_S2MU005_SUPPORT_HMT
	bool "Using HMT"
	depends on USE_MUIC
	default n
	help
		If you say yes here you will get support for
		for the HMT accessory.

config MUIC_UNIVERSAL
	bool "UNIVERSAL MUIC"
	depends on USE_MUIC
	default n
	help
	  If you say yes here you will get support for various MUIC chips.

config MUIC_UNIVERSAL_MAX77865
	bool "MAX77865 MUIC"
	depends on MUIC_UNIVERSAL
	default n
	help
	  If you say yes here you will get support for the MAX77865 MUIC chip.

config MUIC_HV_MAX77865
	bool "MUIC_HV_MAX77865"
	depends on MUIC_UNIVERSAL_MAX77865
	default n
	help
	  If you say yes here you will get support for the AFC.

config MUIC_S2MU004_NON_USB_C_TYPE
	bool "Using S2MU005 MUIC with non usb-c type"
	depends on MUIC_S2MU004
	default n
	help
	  If you say yes here you will get support for
	  for the S2MU004 MUIC non usb-c type chip.

config MUIC_TEST_FUNC
	bool "MUIC supports several function's in TEST"
	depends on SEC_DEBUG && !SAMSUNG_PRODUCT_SHIP
	default n
	help
	  If you say yes here you will get support for the TEST function's.

config TYPEB_WATERPROOF_MODEL
	bool "Using TYPEB WATERPROOF MODEL"
	depends on USE_MUIC
	default n
	help
		If you say yes here you will get support for
		for the  TYPEB WATERPROOF MODEL feature.

config MUIC_SUPPORT_PRSWAP
	bool "MUIC supports power role swap"
	depends on USE_MUIC
	default n
	help
	  If you say yes here you will get support for the power role swap.

config MUIC_SM5504_POGO
	bool "Using SM5504 MUIC for pogo"
	depends on USE_MUIC
	default n
	help
	  If you say yes here you will get support for sm5504 muic pogo.
```

## drivers/nfc/Kconfig
```kconfig
#
# Near Field Communication (NFC) devices
#

menu "Near Field Communication (NFC) devices"

config SEC_NFC
	bool "Samsung NFC driver"
	default n
	help
	  SAMSUNG NFC Driver.
	  This driver provides support for SAMSUNG NFC products.
	  You should select your NFC product and interface.

	  Say Y here to compile support for SAMSUNG NFC driver into the
	  kernel.

config ESE_P3_LSI
	bool "eSE driver"
	depends on SPI
	default n
	help
	  Oberthur Driver.
	  This driver provides support for LSI NXP combined ESE products.
	  You should select your NFC product and interface.

	  Say Y here to compile support for eSE driver into the kernel.

config ESE_COLDRESET
	bool "eSE support coldreset"
	depends on ESE_P3_LSI
	default n
	help
	  Cold reset function supported.
	  This function supports for LSI ESE products.
	  You should select your NFC product and interface.

	  Say Y here to compile support for eSE driver into the kernel.

config ESE_FACTORY_ONLY
	bool "eSE driver factory"
	depends on SPI
	default n
	help
	  Oberthur Driver.
	  This driver provides support for LSI NXP combined ESE products.
	  You should select your NFC product and interface.
	  This option for factory binary.

config NFC_PN547
	bool "NXP PN547 NFC Controller Driver"
	depends on I2C
	default n
	help
	  NXP PN547 Near Field Communication controller support.
	  This option enables device driver support for the NFC.
	  It is used by many services. NFC is fully controlled using I2C
	  to communication.

config NFC_PN547_ESE_SUPPORT
	bool "NXP PN547 ESE SUPPORT"
	depends on NFC_PN547
	default n
	help
	  NXP PN547 Near Field Communication controller support.
	  This option enables device driver support for the NFC.
	  It is used by many services. NFC is fully controlled using I2C
	  to communication

config ESE_SECURE
	bool "ESE Secure Controller Driver"
	depends on !SEC_FACTORY
	default n
	help
	  Common eSE Secure controller support.
	  This option enables device driver support for the eSE with NFC.
	  It is used by many services. eSE is fully controlled using SPI
	  to communication

config ESE_SECURE_SPI_PORT
	int "ese spi port number"
	default	99

config ESE_SECURE_USI_MODE
	int "ese spi port number"
	default	99

config ESE_SECURE_GPIO
	string "gpio group for ese"

config NFC_WILINK
	tristate "Texas Instruments NFC WiLink driver"
	depends on TI_ST && NFC_NCI
	help
	  This enables the NFC driver for Texas Instrument's BT/FM/GPS/NFC
	  combo devices. This makes use of shared transport line discipline
	  core driver to communicate with the NFC core of the combo chip.

	  Say Y here to compile support for Texas Instrument's NFC WiLink driver
	  into the kernel or say M to compile it as module.

config NFC_TRF7970A
	tristate "Texas Instruments TRF7970a NFC driver"
	depends on SPI && NFC_DIGITAL
	help
	  This option enables the NFC driver for Texas Instruments' TRF7970a
	  device. Such device supports 5 different protocols: ISO14443A,
	  ISO14443B, FeLiCa, ISO15693 and ISO18000-3.

	  Say Y here to compile support for TRF7970a into the kernel or
	  say M  to compile it as a module. The module will be called
	  trf7970a.ko.

config NFC_MEI_PHY
	tristate "MEI bus NFC device support"
	depends on INTEL_MEI && NFC_HCI
	help
	  This adds support to use an mei bus nfc device. Select this if you
	  will use an HCI NFC driver for an NFC chip connected behind an
	  Intel's Management Engine chip.

	  If unsure, say N.

config NFC_SIM
	tristate "NFC hardware simulator driver"
	depends on NFC_DIGITAL
	help
	  This driver declares two virtual NFC devices supporting NFC-DEP
	  protocol. An LLCP connection can be established between them and
	  all packets sent from one device is sent back to the other, acting as
	  loopback devices.

	  If unsure, say N.

config NFC_PORT100
	tristate "Sony NFC Port-100 Series USB device support"
	depends on USB
	depends on NFC_DIGITAL
	help
	  This adds support for Sony Port-100 chip based USB devices such as the
	  RC-S380 dongle.

	  If unsure, say N.

source "drivers/nfc/nfc_logger/Kconfig"
endmenu
```

## drivers/nfc/nfc_logger/Kconfig
```kconfig
config SEC_NFC_LOGGER
	bool "NFC logger"
	default n
	---help---
	  Enable NFC logger.
```

## drivers/redriver/Kconfig
```kconfig
#
# Combo redriver devices
#

comment "Redriver IC driver configs"

config REDRIVER
	bool "redriver support"
        default n
	help
		If you say yes here
		you will get support for
		redriver ic for
		usb3.0.

config COMBO_REDRIVER_PS5169
	bool "ps5169 support"
	depends on I2C
	depends on REDRIVER
	default n
	help
		If you say yes here
		you will get support for
		ps5169 redriver ic for
		usb3.0.
```
