## drivers/samsung/Kconfig
```kconfig
# drivers/samsung/Kconfig
#
# Copyright (c) 2010-2019 Samsung Electronics Co., Ltd.
#		http://www.samsung.com/
#
# Licensed under GPLv2

config SEC_EXT
	bool "Samsung TN extension Feature"
	default y

config SEC_REBOOT
	bool "Enable TN reboot features"
	depends on SEC_EXT
	default y
	help
	  Samsung TN reboot extension Feature. Do additional work when reboot.

comment "Samsung sysfs Feature"
config DRV_SAMSUNG
	bool "Samsung sec class/sysfs Feature"
	default y
	depends on SEC_EXT
	help
	  Samsung sysfs name 'sec' directory create.

config SEC_PARAM
	bool "Enable Param modification"
	depends on SEC_DEBUG
	default y
	help
	  Samsung TN Param Feature.

config CM_OFFSET
	int "Charging Mode Offset"
	default 0
	depends on SEC_PARAM
	help
	  set Charging Mode Offset when you enable SEC_PARAM.

config WC_OFFSET
	int "Wireless Charging IC Offset"
	default 0
	depends on SEC_PARAM
	help
	  set Wireless Charging IC Info Offset.

config FMM_LOCK_OFFSET
	int "FMM lock Offset"
	default 0
	depends on SEC_PARAM
	help
	  set FMM lock Offset when you enable SEC_PARAM.

config SEC_KEY_NOTIFIER
	bool "Enable Samsung key event notifier"
	depends on SEC_EXT
	default n
	help
	  Samsung Key input event notifier

comment "Samsung TN Build Options"
config SEC_FACTORY
	bool "SAMSUNG Factory build option"
	depends on SEC_EXT && SEC_DEBUG
	default n
	select SEC_PANIC_PCIE_ERR
	help
	  Include some codes for Factory binary.
	  This option is enabled by Factory build option.
	  In samsung build script, '-F' enables this option.

comment "Samsung TN BSP Options"
config SAMSUNG_PRODUCT_SHIP
	bool "set up for product shipping"
	depends on SEC_EXT
	default n

comment "Samsung TN option for VTS test"
config SEC_VTS_TEST
	bool "VTS TEST"
	default n
	help
	  This option notices this binary for VTS test.

config SEC_DUMP_SINK
	bool "Enable to dump_sink"
	default y
	help
	  This option enables dump_sink.

config ARGOS
	bool "Throughput monitoring Feature"
	default n
	help
	  This option enables monitoring the data throughput and doing several actions for
	  enhancing the performance such as adjusting the CPU freqency, allocating the tasks
	  to the appropriate CPU and so on

config ARGOS_CLUSTER_NUM
	int "The number of CPU clusters (1 ~ 3)"
	range 1 3
	depends on ARGOS
	default 2
	help
	  This option enables that argos supports 3 clusters in SMP nodes.

config SEC_SYSUP
	bool "Samsung System Update"
	default n
	help
	  Samsung system update Feature

comment "Samsung Mobile Power Management Options"
menuconfig SEC_PM
	bool "Samsung Mobile Power Management"
	default y
	help
	  This option enables support for various drivers and features for
	  Samsung Mobile Power Management.

source "drivers/samsung/debug/Kconfig"
source "drivers/samsung/misc/Kconfig"
source "drivers/samsung/pm/Kconfig"
```

## drivers/samsung/pm/Kconfig
```kconfig
# drivers/samsung/pm/Kconfig
#
# Copyright (c) 2010-2019 Samsung Electronics Co., Ltd.
#		http://www.samsung.com/
#
# Licensed under GPLv2
#
config SEC_PM_DEBUG
	bool "Enable Samsung Mobile Power management debug support"
	default y
	depends on SEC_PM
	help
	  This option enables Samsung Mobile Power management debug support.
	  Intended for test and debug only.

config SEC_PM_BIGDATA
	bool "Enable Samsung Mobile Power management big data support"
	default y
	depends on SEC_PM
	help
	  This option enables Samsung Mobile Power management big data support.
```

## drivers/sensors/Kconfig
```kconfig
#
# Sensor  drivers configuration
#

menuconfig SENSORS
	bool "Sensor devices"
	help
	  Say Y here, and a list of sensors drivers will be displayed.
	  Everything that didn't fit into the other categories is here. This option
	  doesn't affect the kernel.

	  If unsure, say Y.

config SENSORS_CORE
	bool "Sensors Class Support"
	help
	  This option enables the sensor sysfs class in /sys/class/sensors.
	  You'll need this to do anything useful with sensorss. If unsure, say N.

config SENSORS_ICM42605M_SPI
	tristate "STMicroelectronics ICM42605M sensor"
	depends on (I2C || SPI) && SYSFS
	help
	   This driver support the STMicroelectronics LSM6DSL sensor.

	   
config SENSORS_ICM42605M
	tristate "TDK Invensense ICM42605M sensor"
	depends on (I2C || SPI) && SYSFS
	help
	   This driver support the TDK Invensense ICM42605M sensor.

	   To compile this driver as a module, choose M here. The module
	   will be called lsm6dsl.

config SENSORS_TMD3725
	depends on I2C
	tristate "TMD3725 driver"
	default n
	help
	   This option enables proximity & light sensors using TMD3725 driver.

config SENSORS_TMD3725_RF_NOISE_DEFENCE_CODE
	depends on SENSORS_TMD3725
	tristate "TMD3725 driver defence code feature"
	default n
	help
	   This option enables proximity using defence code in TMD3725 driver.

config SENSORS_AK09918C
	tristate "AK09918C compass support"
	default n
	depends on I2C
	help
	  If you say yes here you get support for Asahi Kasei's
	  orientation sensor AK09918C.

config SENSORS_GRIP_CHK_HALLIC
	depends on I2C
	tristate "grip sensor check to hallic"
	default n
	help
	 This option enables grip sensors checking hall ic status.

config SENSORS_A96T3X6
	depends on I2C
	tristate "A96T3X6 touchkey"
	default n
	help
	  If you say yes here if you use A96T3X6 for grip.
	  This option enables grip sensors using
	  Above A96T3X6 device driver for grip.

config SENSORS_A96T3X6_SUB
	depends on I2C
	tristate "A96T3X6 driver for grip"
	default n
	help
	  Say Y here if you use A96T3X6 for grip.
	  This option enables grip sensors using
	  Above A96T3X6 device driver for grip.

config SENSORS_A96T3X6_WIFI
	depends on I2C
	tristate "A96T3X6 driver for grip"
	default n
	help
	  Say Y here if you use A96T3X6 for grip.
	  This option enables grip sensors using
	  Above A96T3X6 device driver for grip.

config SENSORS_A96T3X6_2CH
	depends on I2C
	tristate "SENSORS_A96T3X6_2CH driver for grip"
	default n
	help
	  Say Y here if you use SENSORS_A96T3X6_2CH for grip.
	  This option enables grip sensors using
	  Above SENSORS_A96T3X6_2CH device driver for grip.

config SENSORS_A96T3X6_WIFI_2CH
	depends on I2C
	tristate "SENSORS_A96T3X6_WIFI_2CH driver for grip"
	default n
	help
	  Say Y here if you use SENSORS_A96T3X6_WIFI_2CH for grip.
	  This option enables grip sensors using
	  Above SENSORS_A96T3X6_WIFI_2CH device driver for grip.

config SENSOR_A96T3X6_LDO_SHARE
	depends on I2C
	tristate "SENSOR_A96T3X6_LDO_SHARE driver for grip"
	default n
	help
	  Say Y here if you use SENSOR_A96T3X6_LDO_SHARE for grip.
	  This option enables grip sensors using
	  Above SENSOR_A96T3X6_LDO_SHARE device driver for grip.

config SENSORS_A96T3X6_CRC_CHECK
	bool "check crc check instead of checksum compare"
	default n
	help
	  Say Y here if you use crc check instead of checksum compare

config SENSORS_FW_VENDOR
	bool "Locate the Firmware on Vendor"
	default n
	help
	  To use the module automatic system, 
	  locate the firmware on vendor side.
	  DO NOT say Y when ABOV GRIP senseors use a common ldo.

config SENSORS_A96T3X6_GTACTIVE3
	depends on I2C
	tristate "A96T3X6 touchkey"
	default n
	help
	  If you say yes here if you use A96T3X6 for grip.
	  This option enables grip sensors using
	  Above A96T3X6 device driver for grip.
```

## drivers/soc/samsung/Kconfig
```kconfig
#
# SAMSUNG SoC drivers
#
menuconfig SOC_SAMSUNG
	bool "Samsung SoC driver support" if COMPILE_TEST

if SOC_SAMSUNG
config EXYNOS_CHIPID
	bool "Exynos Chip ID Driver Support"
	depends on ARCH_EXYNOS
	select SOC_BUS

config EXYNOS_PMU
	bool "Exynos Power Management Unit Driver Support"
	depends on ARCH_EXYNOS
	select MFD_SYSCON

config ECT
	bool "Enable Exynos Characteristic Table File"
	default n
	depends on ARCH_EXYNOS

config ECT_DUMP
	bool "Enable Exynos Characteristic Table File Dump sysfs"
	default n
	depends on ECT

config EXYNOS_PD
	bool "Exynos PM domain Support"
	depends on ARCH_EXYNOS
	depends on PM
	select PM_GENERIC_DOMAINS

config EXYNOS_RGT
	bool "Exynos Regulator Debug Support"
	depends on REGULATOR
	depends on DEBUG_FS
	depends on OF
	help
	  dummy device driver for debugging samsung PMIC

config EXYNOS_BCM
	bool "EXYNOS_BCM driver support"
	default n
	help
	  Enable exynos_bcm driver support

config CAL_IF
	bool "Exynos Chip Abstraction Layer Interface"
	help
	  Support CMU CAL for Exynos SoC.

config EXYNOS_REBOOT
	bool "Exynos Chip Reboot Driver Support"
	depends on ARCH_EXYNOS

config CMU_EWF
	bool "exynos early wakeup force enable"
	depends on CAL_IF
	default y
	help
	  Support CMUEWF for Exynos SoC.

config EXYNOS_PM_DVS
       bool "Enable Exynos dynamic voltage setting"
       default n

config PMUCAL
	bool "Exynos PMU Chip Abstraction Layer"
	depends on CAL_IF
	default y
	help
	 Support PMUCAL for Exynos SoC.

config FLEXPMU
	bool "Exynos FLEXPMU"
	depends on PMUCAL
	default n
	help
	 Support PMUCAL for Exynos SoC.

config EXYNOS_FLEXPMU_DBG
	bool "Exynos FLEXPMU DBG"
	depends on FLEXPMU
	default y
	help
	 Support FLEXPMU for Exynos SoC.

config CMUCAL
	bool "Exynos CMU Chip Abstraction Layer"
	depends on CAL_IF
	default y
	help
	  Support CMUCAL for Exynos SoC.

config CP_PMUCAL
	bool "Exynos PMU(for CP) Chip Abstraction Layer"
	depends on CAL_IF
	help
	  Support CP_PMUCAL for Exynos SoC.

config CMUCAL_DEBUG
	bool "CMUCAL Debug Interface"
	depends on CMUCAL

config CMUCAL_QCH_IGNORE_SUPPORT
	bool "CMUCAL QCH IGNORE Support"
	depends on CMUCAL

config ACPM_DVFS
	bool "Exynos ACPM DVFS manager"
	depends on CAL_IF && CMUCAL
	default y
	help
	  Support ACPM DVFS for Exynos SoC.

config EXYNOS_PM_DOMAINS
	bool "Exynos PM domains" if COMPILE_TEST
	depends on PM_GENERIC_DOMAINS || COMPILE_TEST

source "drivers/soc/samsung/acpm/Kconfig"

config EXYNOS_CONTENT_PATH_PROTECTION
	bool "Exynos Content Path Protection"
	default y
	help
	  Enable content path protection of EXYNOS.

config USI_V2
	bool "Enable Universal Serial Interface version 2"
	default n

config USI
	bool "Enable Universal Serial Interface"
	default y

config EXYNOS_HOTPLUG_GOVERNOR
	bool "Exynos HOTPLUG Governor"
	default n
	depends on ARCH_EXYNOS
	depends on CPU_FREQ
	depends on HOTPLUG_CPU
	help
	  Enable HOTPLUG Governor for Exynos SoC.
	  This module controls number of online cpu.

config EXYNOS_DVFS_MANAGER
	bool "Exynos DVFS Manager"
	default n
	depends on ARCH_EXYNOS
	help
	  Enable DVFS Manager for Exynos SoC.
	  This module controls constraint between each DVFS domains.

config EXYNOS_SDM
	bool "Exynos Security Dump Manager Support"
	depends on EXYNOS_SNAPSHOT
	default y
	help
	  Exynos Security Dump Manager

config EXYNOS_OCP
	bool "Exynos OCP Handler"
	depends on CPU_FREQ
	default n
	help
	  Enable OCP handler for Exynos SoC.

config EXYNOS_MCINFO
	bool "Exynos memory controller information"
	default n

config MCINFO_SYSFS
	bool "Exynos memory controller information sysfs"
	depends on EXYNOS_MCINFO
	default	y if SYSFS

config EXYNOS_SECURE_LOG
	bool "Exynos Secure Log"
	default y
	help
	  Support Exynos Secure Log

config EXYNOS_KERNEL_PROTECTION
	bool "Exynos Kernel Code Protection"
	help
	  Support Exynos Kernel Code Protection

config EXYNOS_SMC_LOG_THRESHOLD
	int "threshold of detection(microsecond)"
	range 0 1000000
	default 0

config EXYNOS_SNAPSHOT_LOGGING_SMC_CALL
	bool "Support logging SMC call"
	depends on EXYNOS_SNAPSHOT
	default y

source "drivers/soc/samsung/exynos-hdcp/Kconfig"

config SENSORS_FP_USI_NUMBER
	depends on SENSORS_FINGERPRINT
	int "Fingerprint usi gpio number"
	default 0

endif
```

## drivers/usb/typec/Kconfig
```kconfig
menu "USB Power Delivery and Type-C drivers"

config TYPEC
	tristate
	default y

endmenu
```
