## drivers/vibrator/Kconfig
```kconfig
source "drivers/vibrator/common/Kconfig"

source "drivers/vibrator/dc/Kconfig"

source "drivers/vibrator/imagis/Kconfig"
```

## drivers/vibrator/common/Kconfig
```kconfig
config SEC_VIBRATOR
	tristate "sec vibrator"
	default n
	help
	  If you say yes here you will get support for the
	  sec vibrator driver
```

## drivers/vibrator/dc/Kconfig
```kconfig
#
#
#
config DC_VIBRATOR
	tristate "SEC DC Vibrator"
	default n
	help
	  If you say yes here you will get support for the
	  SEC DC Vibrator.
```

## drivers/vibrator/imagis/Kconfig
```kconfig
config ISA1000_VIBRATOR
	tristate "isa1000 vibrator"
	default n
	help
	  If you say yes here you will get support for the
	  isa1000 vibrator driver
```

## drivers/video/fbdev/exynos/Kconfig
```kconfig
if SOC_EXYNOS9810

source "drivers/video/fbdev/exynos/dpu_9810/Kconfig"

endif # SOC_EXYNOS9810
```

## drivers/video/fbdev/exynos/dpu_9810/Kconfig
```kconfig
config EXYNOS_DECON_9810
	bool "Samsung Exynos9810 Display system (DPP, DECON, MIPI, HDMI)"
	default y
	depends on FB

if EXYNOS_DECON_9810
config EXYNOS_DECON_FB
	bool "Samsung DECON Framebuffer driver"
	depends on EXYNOS_DECON_9810
	select MEDIA_EXYNOS
	default y
	help
	  Say Y here if you want support for the DECON in Samsung S5P SoCs.
	  This device produce image data to one of output interfaces.

config EXYNOS_DPP
	bool "Samsung Exynos Display Post Processor driver"
	depends on EXYNOS_DECON_9810
	default y

config EXYNOS_MIPI_DSIM
	bool "Samsung Exynos MIPI-DSI driver"
	depends on EXYNOS_DECON_9810
	default y
	help
	  Enable MIPI-DSI driver.

config EXYNOS_DISPLAYPORT
	bool "Samsung Exynos DISPLAYPORT driver"
	depends on EXYNOS_DECON_9810
	default y
	help
	  Enable DISPLAYPORT driver.

config DISPLAYPORT_ENG
	bool "Samsung Exynos Displayport eng build"
	depends on EXYNOS_DISPLAYPORT
	default n

config LOGGING_BIGDATA_BUG
	bool "Logging extra information when decon bug"
	depends on EXYNOS_DECON_9810
	default y

config EXYNOS_ZEBU_EMUL_DISP
	bool "Zebu Emulator Display driver"
	depends on EXYNOS_DECON_9810
	default n

config EXYNOS_DUAL_DSI
	bool "Dual Dsi"
	depends on EXYNOS_MIPI_DSIM
	default n

config FB_WINDOW_UPDATE
        bool "DECON window update mode"
        depends on EXYNOS_DECON_9810
        default n

config DECON_BLOCKING_MODE
	bool "DECON blocking mode"
        depends on EXYNOS_DECON_9810
        default y

config DECON_EVENT_LOG
	bool "Display sub-system event logger (DECON/DSIM/DPP)"
        depends on DEBUG_INFO && EXYNOS_DECON_9810
        default y

config DECON_HIBER
	bool "DECON hiber mode"
        depends on EXYNOS_DECON_9810
        default n

config EXYNOS_HIBERNATION_THREAD
	bool "DECON hiber mode using single thread"
        depends on DECON_HIBER
        default n

config SUPPORT_DOZE
	bool "Suppot Doze mode to aod service"
		depends on EXYNOS_DECON_9810
		default n

config EXYNOS_AFBC
	bool "Display sub-system AFBC stream"
        depends on EXYNOS_DECON_9810
        default n

config EXYNOS_DSIM_DITHER
	bool "DSIM SSCG feature"
        depends on EXYNOS_MIPI_DSIM
        default y

config DECON_BTS_LEGACY
	bool "Legacy BTS scheme of display"
        depends on EXYNOS_DECON_9810
        default n

config DPU_2_0_FENCE
	bool "fence is signaled at the beginning of a frame"
        depends on EXYNOS_DECON_9810
        default n

config FB_TEST
	bool "FB test only"
        depends on EXYNOS_DECON_9810
        default n

config DSIM_CMD_TEST
	bool "DSIM command test only"
        depends on EXYNOS_DECON_9810
        default n

config DPU_2_0_RELEASE_FENCES
	bool "Release fence FD is created per each enable window"
        depends on EXYNOS_DECON_9810
        default n

config SUPPORT_DSU
	tristate "Support Dynamic Scale Up (Multi-Resolution)"
	depends on EXYNOS_DECON_9810
	default n

config USE_DISPLAYPORT_CCIC_EVENT_QUEUE
	bool "use queue for CCIC notifications"
        depends on EXYNOS_DISPLAYPORT
        default n
endif

source "drivers/video/fbdev/exynos/dpu_9810/panels/Kconfig"
source "drivers/video/fbdev/exynos/dpu_9810/dp_logger/Kconfig"
```

## drivers/video/fbdev/exynos/dpu_9810/dp_logger/Kconfig
```kconfig
config SEC_DISPLAYPORT_LOGGER
	bool "DISPLAYPORT logger"
	default n
	---help---
	  Enable DISPLAYPORT logger.

config SEC_DISPLAYPORT_BIGDATA
	bool "DISPLAYPORT bigdata"
	depends on !SEC_FACTORY
	default n
	---help---
	  Enable DISPLAYPORT bigdata.

config SEC_DISPLAYPORT_SELFTEST
	bool "DISPLAYPORT self test"
	depends on DISPLAYPORT_ENG
	default n
	help
	 This config is for supporting DISPLAYPORT self test.
	 1. check if displayport is enabled.
	 2. check if resolution is correct.
	 3. additional functions can be added.
```

## drivers/video/fbdev/exynos/dpu_9810/panels/Kconfig
```kconfig
config EXYNOS_DECON_LCD
	depends on EXYNOS_DECON_9810
	bool "Select LCD panel driver"

config EXYNOS_COMMON_PANEL
	depends on EXYNOS_DECON_LCD && EXYNOS_MIPI_DSIM
	tristate "S6E3HA2K AMOLED WQHD LCD driver(1440 x 2560)"
	default y

config EXYNOS_DECON_LCD_S6E3HA2K
	depends on EXYNOS_DECON_LCD && EXYNOS_MIPI_DSIM
	tristate "S6E3HA2K AMOLED WQHD LCD driver(1440 x 2560)"

config EXYNOS_DECON_LCD_S6E3HF4
	depends on EXYNOS_DECON_LCD && EXYNOS_MIPI_DSIM
	tristate "S6E3HF4 AMOLED WQHD LCD driver(1440 x 2560)"
	default n

config EXYNOS_DECON_LCD_S6E3HA6
	depends on EXYNOS_DECON_LCD && EXYNOS_MIPI_DSIM
	depends on SOC_EXYNOS9810_EVT0
	tristate "S6E3HA6 AMOLED WQHD+ LCD driver(1440 x 2960)"
	default n

config EXYNOS_DECON_LCD_S6E3HA8
	depends on EXYNOS_DECON_LCD && EXYNOS_MIPI_DSIM
	depends on SOC_EXYNOS9810_EVT1
	tristate "S6E3HA8 AMOLED WQHD+ LCD driver(1440 x 2960)"
	default n

config EXYNOS_DECON_LCD_EMUL_DISP
	depends on EXYNOS_DECON_LCD && EXYNOS_MIPI_DSIM
	depends on EXYNOS_ZEBU_EMUL_DISP
	tristate "EMUL_DISP COMMAND/VIDEO MODE AMOLED FHD LCD driver(800 x 1280)"

config EXYNOS_MASS_PANEL
	depends on EXYNOS_DECON_LCD && EXYNOS_MIPI_DSIM
	tristate "mass panel driver"
	default n

config DISPLAY_USE_INFO
	depends on EXYNOS_DECON_LCD
	tristate "Support display use info logging"
	default n

config EXYNOS_DECON_MDNIE
	depends on EXYNOS_DECON_LCD
	tristate "Support MDNIE"
	default n

config EXYNOS_DECON_LCD_ANA6705_A51
	depends on EXYNOS_DECON_LCD && EXYNOS_MIPI_DSIM
	tristate "ANA6705_A51 LCD driver"

config EXYNOS_DECON_LCD_S6E3FA9_ANOTE
	depends on EXYNOS_DECON_LCD && EXYNOS_MIPI_DSIM
	tristate "S6E3FA9_ANOTE LCD driver"

config EXYNOS_DECON_LCD_HX83102E_GTACTIVE3
	depends on EXYNOS_DECON_LCD && EXYNOS_MIPI_DSIM
	tristate "HX83102E_GTACTIVE3 LCD driver"

config EXYNOS_LCD_ENG
	depends on EXYNOS_DECON_LCD
	tristate "Support LCD featue on ENG binary"
	default n

config SUPPORT_MASK_LAYER
	bool "Support mask layer"
	default n
```

## sound/soc/codecs/dbmdx/Kconfig
```kconfig
#
# DBMDX SoC audio configuration
#
#

# DBMDX SOC enabler.
# .
# y - Enable DSPG VT/VE Chip
# n - Disable DSPG VT/VE Chip
config SND_SOC_DBMDX
	bool "DSPG Voice Trigger/Enhancement Chip"
	default n
	help
		DSPG Voice Trigger/Enhancement Chip
		.
		y - Enable DSPG VT/VE Chip
		n - Disable DSPG VT/VE Chip

# Register DBMDX SOC as a separate sound card.
# .
# y - Register DBMDX SOC as separate sound card
# n - Do not register DBMDX SOC as separate sound card
config SND_SOC_DBMDX_SND_CAPTURE
	bool "DSPG Capture Device Support"
	depends on SND_SOC_DBMDX
	default n
	help
		Register DBMDX SOC as a separate sound card.
		.
		y - Register DBMDX SOC as separate sound card
		n - Do not register DBMDX SOC as separate sound card


# Noise Suppression Algorithm Support (Only DBMD8 chip)
# .
# y - Enable Noise Suppression Algorithm Support
# n - Do not enable Noise Suppression Algorithm Support
config SND_SOC_DBMDX_VA_NS_SUPPORT
	bool "Noise Suppression Algorithm Support (Only DBMD8 chip)"
	depends on SND_SOC_DBMDX
	default n
	help
		Noise Suppression Algorithm Support (Only DBMD8 chip).
		.
		y - Enable Noise Suppression Algorithm Support
		n - Do not enable Noise Suppression Algorithm Support
```

## sound/soc/codecs/tas2562/Kconfig
```kconfig
menuconfig SND_SOC_TAS2562
	tristate "Texas Instruments TAS2562 SmartAmp(R)"

if SND_SOC_TAS2562
config TAS2562_REGMAP
    bool "Use of RegMap API"
    help
      Enable support for TAS2562 regmap driver.
      This includes i2c i2c driver structure,
      IRQ processing, registers read and write
      by i2c operations.

config TAS2562_CODEC
    bool "Codec Driver support"
    help
      Enable support for TAS2562 codec driver.
      This includes codec driver interfaces
      and functions.

config PLATFORM_EXYNOS
    bool "Exynos platform support"
    default y
    help
      Enable support for Exynos platformt.

config TAS25XX_ALGO
    bool "TAS2562 Calibration Support"
    depends on SND_SOC_TAS2562
    help 
      Enable support for TAS25xx Calibration driver.
      This includes TAS2562 Calibration driver interfaces
      and functions.

#config TAS2558_CODEC

#config TAS2562_MISC
#    bool "Misc Driver support"

endif # SND_SOC_TAS2562
```
